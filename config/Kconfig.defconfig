## config/Kconfig.defconfig
```kconfig
if SHIELD_Helix58_LEFT

config ZMK_KEYBOARD_NAME
    default "Helix58SW"

config ZMK_SPLIT_ROLE_CENTRAL
    default y

endif

if SHIELD_Helix58_left || SHIELD_Helix58_right

config ZMK_SPLIT
    default y

endif
```

## config/Kconfig.shield
```kconfig
config SHIELD_HELIX58
    def_bool $(shields_list_contains,Helix58_left)

config SHIELD_HELIX58
    def_bool $(shields_list_contains,Helix58_right)
```

## config/boards/shields/Helix58/Kconfig.defconfig
```kconfig
if SHIELD_HELIX58_LEFT

config ZMK_KEYBOARD_NAME
    default "Helix58SW"

config ZMK_SPLIT_ROLE_CENTRAL
    default y

config ZMK_SLEEP
    default y

config ZMK_IDLE_SLEEP_TIMEOUT
    default 300000
    
endif

if SHIELD_HELIX58_LEFT || SHIELD_HELIX58_RIGHT

config ZMK_SPLIT
    default y

endif
```

## config/boards/shields/Helix58/Kconfig.shield
```kconfig
config SHIELD_HELIX58_LEFT
    def_bool $(shields_list_contains,Helix58_left)

config SHIELD_HELIX58_RIGHT
    def_bool $(shields_list_contains,Helix58_right)
```
